/dts-v1/;

/ {
	overlay-name = "Jetson 40pin Header";
	compatible = "nvidia,p3449-0000-b00+p3448-0002-b00", "nvidia,jetson-nano", "nvidia,tegra210";

	fragment@0 {
		target = <0xffffffff>;

		__overlay__ {
			pinctrl-names = "default";
			pinctrl-0 = <0x1>;

			exp-header-pinmux {
				linux,phandle = <0x1>;
				phandle = <0x1>;

				hdr40-pin3 {
					nvidia,pins = "gen2_i2c_sda_pj3";
				};

				hdr40-pin5 {
					nvidia,pins = "gen2_i2c_scl_pj2";
				};

				hdr40-pin7 {
					nvidia,pins = "aud_mclk_pbb0";
					nvidia,function = "aud";
					nvidia,pin-group = "aud_mclk";
					nvidia,pull = <0x0>;
					nvidia,tristate = <0x0>;
					nvidia,enable-input = <0x0>;
				};

				hdr40-pin8 {
					nvidia,pins = "uart2_tx_pg0";
				};

				hdr40-pin10 {
					nvidia,pins = "uart2_rx_pg1";
				};

				hdr40-pin11 {
					nvidia,pins = "uart2_rts_pg2";
					nvidia,function = "uartb";
					nvidia,pin-group = "uartb-cts/rts";
					nvidia,pull = <0x0>;
					nvidia,tristate = <0x0>;
					nvidia,enable-input = <0x0>;
				};

				hdr40-pin12 {
					nvidia,pins = "dap4_sclk_pj7";
					nvidia,function = "i2s4b";
					nvidia,pin-group = "i2s4";
					nvidia,pin-label = "i2s4b_sclk";
					nvidia,pull = <0x1>;
					nvidia,tristate = <0x0>;
					nvidia,enable-input = <0x1>;
				};

				hdr40-pin13 {
					nvidia,pins = "spi2_sck_pb6";
					nvidia,function = "spi2";
					nvidia,pin-label = "spi2_sck";
					nvidia,pull = <0x1>;
					nvidia,tristate = <0x0>;
					nvidia,enable-input = <0x1>;
				};

				hdr40-pin16 {
					nvidia,pins = "spi2_cs1_pdd0";
					nvidia,function = "spi2";
					nvidia,pin-label = "spi2_cs1";
					nvidia,pull = <0x2>;
					nvidia,tristate = <0x0>;
					nvidia,enable-input = <0x1>;
				};

				hdr40-pin18 {
					nvidia,pins = "spi2_cs0_pb7";
					nvidia,function = "spi2";
					nvidia,pin-label = "spi2_cs0";
					nvidia,pull = <0x2>;
					nvidia,tristate = <0x0>;
					nvidia,enable-input = <0x1>;
				};

				hdr40-pin19 {
					nvidia,pins = "spi1_mosi_pc0";
					nvidia,function = "spi1";
					nvidia,pin-label = "spi1_dout";
					nvidia,pull = <0x1>;
					nvidia,tristate = <0x0>;
					nvidia,enable-input = <0x1>;
				};

				hdr40-pin21 {
					nvidia,pins = "spi1_miso_pc1";
					nvidia,function = "spi1";
					nvidia,pin-label = "spi1_din";
					nvidia,pull = <0x1>;
					nvidia,tristate = <0x0>;
					nvidia,enable-input = <0x1>;
				};

				hdr40-pin22 {
					nvidia,pins = "spi2_miso_pb5";
					nvidia,function = "spi2";
					nvidia,pin-label = "spi2_din";
					nvidia,pull = <0x1>;
					nvidia,tristate = <0x0>;
					nvidia,enable-input = <0x1>;
				};

				hdr40-pin23 {
					nvidia,pins = "spi1_sck_pc2";
					nvidia,function = "spi1";
					nvidia,pin-label = "spi1_sck";
					nvidia,pull = <0x1>;
					nvidia,tristate = <0x0>;
					nvidia,enable-input = <0x1>;
				};

				hdr40-pin24 {
					nvidia,pins = "spi1_cs0_pc3";
					nvidia,function = "spi1";
					nvidia,pin-label = "spi1_cs0";
					nvidia,pull = <0x2>;
					nvidia,tristate = <0x0>;
					nvidia,enable-input = <0x1>;
				};

				hdr40-pin26 {
					nvidia,pins = "spi1_cs1_pc4";
					nvidia,function = "spi1";
					nvidia,pin-label = "spi1_cs1";
					nvidia,pull = <0x2>;
					nvidia,tristate = <0x0>;
					nvidia,enable-input = <0x1>;
				};

				hdr40-pin27 {
					nvidia,pins = "gen1_i2c_sda_pj0";
				};

				hdr40-pin28 {
					nvidia,pins = "gen1_i2c_scl_pj1";
				};

				hdr40-pin32 {
					nvidia,pins = "lcd_bl_pwm_pv0";
					nvidia,function = "pwm0";
					nvidia,pull = <0x0>;
					nvidia,tristate = <0x0>;
					nvidia,enable-input = <0x0>;
				};

				hdr40-pin33 {
					nvidia,pins = "pe6";
					nvidia,function = "pwm2";
					nvidia,pull = <0x0>;
					nvidia,tristate = <0x0>;
					nvidia,enable-input = <0x0>;
				};

				hdr40-pin35 {
					nvidia,pins = "dap4_fs_pj4";
					nvidia,function = "i2s4b";
					nvidia,pin-group = "i2s4";
					nvidia,pin-label = "i2s4b_fs";
					nvidia,pull = <0x1>;
					nvidia,tristate = <0x0>;
					nvidia,enable-input = <0x1>;
				};

				hdr40-pin36 {
					nvidia,pins = "uart2_cts_pg3";
					nvidia,function = "uartb";
					nvidia,pin-group = "uartb-cts/rts";
					nvidia,pull = <0x2>;
					nvidia,tristate = <0x1>;
					nvidia,enable-input = <0x1>;
				};

				hdr40-pin37 {
					nvidia,pins = "spi2_mosi_pb4";
					nvidia,function = "spi2";
					nvidia,pin-label = "spi2_dout";
					nvidia,pull = <0x1>;
					nvidia,tristate = <0x0>;
					nvidia,enable-input = <0x1>;
				};

				hdr40-pin38 {
					nvidia,pins = "dap4_din_pj5";
					nvidia,function = "i2s4b";
					nvidia,pin-group = "i2s4";
					nvidia,pin-label = "i2s4b_din";
					nvidia,pull = <0x1>;
					nvidia,tristate = <0x1>;
					nvidia,enable-input = <0x1>;
				};

				hdr40-pin40 {
					nvidia,pins = "dap4_dout_pj6";
					nvidia,function = "i2s4b";
					nvidia,pin-group = "i2s4";
					nvidia,pin-label = "i2s4b_dout";
					nvidia,pull = <0x1>;
					nvidia,tristate = <0x0>;
					nvidia,enable-input = <0x0>;
				};
			};
		};
	};

	__symbols__ {
		jetson_io_pinmux = "/fragment@0/__overlay__/exp-header-pinmux";
	};

	__fixups__ {
		pinmux = "/fragment@0:target:0";
	};

	__local_fixups__ {

		fragment@0 {

			__overlay__ {
				pinctrl-0 = <0x0>;
			};
		};
	};
};
